## conf/distro/poky-systemd-x11.conf
```bitbake
require poky-systemd.conf

PREFERRED_PROVIDER_virtual/xserver ?= "xserver-xorg"

DISTRO = "poky-systemd-x11"
DISTRO_FEATURES_append = " x11"
```

## conf/distro/poky-systemd.conf
```bitbake
require conf/distro/poky.conf
DISTRO = "poky-systemd"

DISTRO_FEATURES = "alsa argp ext2 largefile usbgadget usbhost ipv4 wifi xattr nfs zeroconf pci ${DISTRO_FEATURES_LIBC}"

# use bluez5
BBMASK .= "|meta/recipes-connectivity/bluez/"
PREFERRED_PROVIDER_bluez4 = "bluez5"
PREFERRED_PROVIDER_bluez-hcidump = "bluez5"

# enable networkd and resolved in systemd build, add dhcp-client to images
PACKAGECONFIG_pn-systemd = "xz resolved networkd"
DISTRO_EXTRA_RRECOMMENDS += "dhcp-client"

# Use systemd rather than sysvinit
DISTRO_FEATURES_append = " systemd"
VIRTUAL-RUNTIME_init_manager = "systemd"

#prevent sysvinit auto enable and remove all initscripts
DISTRO_FEATURES_BACKFILL_CONSIDERED += "sysvinit"
VIRTUAL-RUNTIME_initscripts = ""
VIRTUAL-RUNTIME_syslog = ""
```

## conf/machine/edison.conf
```bitbake
#@TYPE: Machine
#@NAME: edison

#@DESCRIPTION: Machine configuration for edison systems

PREFERRED_PROVIDER_virtual/kernel ?= "linux-yocto"
PREFERRED_VERSION_linux-yocto = "3.10%"
KERNEL_IMAGETYPE = "bzImage"

PREFERRED_PROVIDER_virtual/bootloader ?=  "u-boot"
PREFERRED_VERSION_u-boot ?= "2014.04-1"
PREFERRED_VERSION_u-boot-fw-utils ?= "2014.04-1"
UBOOT_MACHINE = "edison_config"

# This sets compilation options close to what is used on android
include conf/machine/include/tune-atom.inc
TUNE_CCARGS .= " -mstackrealign -fno-omit-frame-pointer"

MACHINE_FEATURES = "bluetooth alsa pci serial usbgadget usbhost wifi x86 ext3"
IMAGE_FSTYPES = "ext4"
SERIAL_CONSOLES = "115200;ttyMFD2"

MACHINE_ESSENTIAL_EXTRA_RRECOMMENDS = "kernel-module-bcm-bt-lpm"
KERNEL_MODULE_AUTOLOAD = "bcm_bt_lpm"

MACHINE_ESSENTIAL_EXTRA_RRECOMMENDS = "bcm43340-mod"
KERNEL_MODULE_AUTOLOAD  += "bcm4334x"
KERNEL_MODULE_PROBECONF += "bcm4334x"
module_conf_bcm4334x = "options bcm4334x firmware_path=/etc/firmware/fw_bcmdhd.bin nvram_path=/etc/firmware/bcmdhd.cal"

MACHINE_ESSENTIAL_EXTRA_RRECOMMENDS = "kernel-module-g-multi"
KERNEL_MODULE_AUTOLOAD  += "g_multi"
KERNEL_MODULE_PROBECONF += "g_multi"
# FIXME: file parameter should be based on partition UUID (from U-Boot) or fixed
# with label (label seems to work, but driver is probed too early)
module_conf_g_multi = "options g_multi file=/dev/mmcblk0p9 stall=0 idVendor=0x8087 idProduct=0x0A9E iProduct=Edison iManufacturer=Intel"
```

## conf/machine/include/edison-image-config.inc
```bitbake
# include this file to customize standard Yocto images for edison

IMAGE_FEATURES += "debug-tweaks package-management ssh-server-openssh"
```
